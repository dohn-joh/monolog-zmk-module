## boards/shields/monolog/Kconfig.defconfig
```kconfig
if SHIELD_MONOLOG_DONGLE

config ZMK_KEYBOARD_NAME
    default "Monolog Keyboard"

config ZMK_SPLIT_ROLE_CENTRAL
    default y

endif

if SHIELD_MONOLOG_MAIN || SHIELD_MONOLOG_DONGLE

config ZMK_SPLIT
    default y

endif
```

## boards/shields/monolog/Kconfig.shield
```kconfig
config SHIELD_MONOLOG_MAIN
    def_bool $(shields_list_contains,monolog_main)

config SHIELD_MONOLOG_DONGLE
    def_bool $(shields_list_contains,monolog_dongle)
```
