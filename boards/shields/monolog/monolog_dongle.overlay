#include "monolog.dtsi"

// dummy cols/rows
&kscan0 {
	col-gpios
	= <&pro_micro 5 (GPIO_ACTIVE_HIGH)>
	;
    row-gpios
	= <&pro_micro 6 (GPIO_ACTIVE_HIGH | GPIO_PULL_DOWN)>
    ;
};

&left_encoder {
    status = "okay";
};

&right_encoder {
    status = "okay";
};
